/*
 * Uno WiFi Serial1 library example.
 * ConfigurableFirmata generated sketch modified for ATmega on Uno WiFi
 * to be slave for ESP8266 sketch with FirmataMaster library
 *
 * lines added for UNO Wifi to this .ino created by FirmataBuilder
 * are commented
 *
 * Note: to use Serial (HW_SERIAL0) with Firmata Serial Feature,
 *   uncomment "return &Serial" in Firmata library
 *   in file SerialFirmata.cpp function SerialFirmata::getPortFromId
 *
 * example created by Juraj AndrАssy
 */

/*
 * UnoWiFiFirmata.ino generated by FirmataBuilder
 * Sun Dec 10 2017 09:40:25 GMT-0500 (EST)
 */

// added for UNO WiFi
#include <UnoWiFiDevEdSerial1.h>
#define UPLOAD_BAUD 230400
//

#include <ConfigurableFirmata.h>

#include <DigitalInputFirmata.h>
DigitalInputFirmata digitalInput;

#include <DigitalOutputFirmata.h>
DigitalOutputFirmata digitalOutput;

#include <AnalogInputFirmata.h>
AnalogInputFirmata analogInput;

#include <AnalogOutputFirmata.h>
AnalogOutputFirmata analogOutput;

#include <SerialFirmata.h>
SerialFirmata serial;

#include <FirmataExt.h>
FirmataExt firmataExt;

#include <AnalogWrite.h>

#include <FirmataReporting.h>
FirmataReporting reporting;

void systemResetCallback()
{
  for (byte i = 0; i < TOTAL_PINS; i++) {
    if (IS_PIN_ANALOG(i)) {
      Firmata.setPinMode(i, ANALOG);
    } else if (IS_PIN_DIGITAL(i)) {
      Firmata.setPinMode(i, OUTPUT);
    }
  }
  firmataExt.reset();
}

void initTransport()
{
  Firmata.disableBlinkVersion();

  // changed for UNO WiFi
  Serial1.begin(57600);
  Firmata.begin(Serial1);
}

void initFirmata()
{
  Firmata.setFirmwareVersion(FIRMATA_FIRMWARE_MAJOR_VERSION, FIRMATA_FIRMWARE_MINOR_VERSION);

  firmataExt.addFeature(digitalInput);
  firmataExt.addFeature(digitalOutput);
  firmataExt.addFeature(analogInput);
  firmataExt.addFeature(analogOutput);
  firmataExt.addFeature(serial);
  firmataExt.addFeature(reporting);

  Firmata.attach(SYSTEM_RESET, systemResetCallback);
}

void setup()
{
  initFirmata();

  initTransport();

  systemResetCallback();

  // added for UNO WiFi
  Serial1.resetESP(); // to bridge the reset
  detectEspFlashing(); // and it is a delay for ESP side setup
}

void loop()
{
  digitalInput.report();

  while(Firmata.available()) {
    Firmata.processInput();
  }

  if (reporting.elapsed()) {
    analogInput.report();
  }

  serial.update();
}

//added for UNO WiFi to bridge flashing of ESP from IDE
void detectEspFlashing() {
  const byte syncFrame[] = {0xC0, 0x00, 0x08, 0x24, 0x00, 0xDD, 0x00, 0x00, 0x00, 0x07, 0x07, 0x12, 0x20};
  byte syncFrameIndex = 0;
  Serial.begin(UPLOAD_BAUD);
  while (millis() < 2000) { // 2 seconds after reset
    if (!Serial.available())
      continue;
    byte b = Serial.read();
    if (b == -1)
      return;
    if (b != syncFrame[syncFrameIndex]) {
      syncFrameIndex = 0;
    } else {
      syncFrameIndex++;
      if (syncFrameIndex == sizeof(syncFrame)) {
        Serial1.begin(UPLOAD_BAUD);
        Serial1.resetESP(true); // reset to bootloader
        while (true) {
          while (Serial.available()) {
            Serial1.write(Serial.read());
          }
          while (Serial1.available()) {
            Serial.write(Serial1.read());
          }
        }
      }
    }
  }
  Serial.end(); // to free it for Firmata Serial
}
